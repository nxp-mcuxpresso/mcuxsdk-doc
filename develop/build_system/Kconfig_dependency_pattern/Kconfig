## develop/build_system/Kconfig_dependency_pattern/Kconfig
```kconfig
menu "Dependency condition"

	config MCUX_HW_CORE_CM4F
		bool "core cm4f"

	config MCUX_HW_DEVICE_MK64F12
		bool "Device MK64F12"
    
    config MCUX_HW_DEVICE_LPC54005 
        bool "Device LPC54005"
    
    config MCUX_HW_DEVICE_LPC54016 
        bool "Device LPC54016"
    
    config MCUX_HW_DEVICE_LPC54018 
        bool "Device LPC54018"
    
    config MCUX_HW_DEVICE_LPC54018M 
        bool "Device LPC54018M"
    
    config MCUX_HW_DEVICE_LPC54628
        bool "Device LPC54628"

    config MCUX_COMPILER_IAR
        bool "Compiler IAR"

    config MCUX_HAS_COMPONENT_component3
        bool
        default y

    config MCUX_HAS_COMPONENT_component4
        bool

endmenu


menu "Dependency Pattern"

    config MCUX_COMPONENT_componentA
        bool "Component A, choice pattern"
        select MCUX_COMPONENT_component1 
        select MCUX_COMPONENT_component2
        depends on !MCUX_HW_DEVICE_MK64F12 && !MCUX_HW_DEVICE_MK63F12 # not
        if MCUX_COMPONENT_componentA
            choice
                prompt "Component A anyOf1"
                default MCUX_DEPENDENCY_COMPONENT_componentA_DEPEND_ANYOF_1
                config MCUX_DEPENDENCY_COMPONENT_componentA_DEPEND_ANYOF_1
                    bool "Select component3"
                    select MCUX_COMPONENT_component3

                config MCUX_DEPENDENCY_COMPONENT_componentA_DEPEND_ANYOF_2
                    bool "Select component4"
                    select MCUX_COMPONENT_component4
            endchoice  
            choice
                prompt "Component A anyOf2"
                default MCUX_DEPENDENCY_COMPONENT_componentA_DEPEND_ANYOF_3
                config MCUX_DEPENDENCY_COMPONENT_componentA_DEPEND_ANYOF_3
                    bool "Select component5"
                    select MCUX_COMPONENT_component5

                config MCUX_DEPENDENCY_COMPONENT_componentA_DEPEND_ANYOF_4
                    bool "Select component6"
                    select MCUX_COMPONENT_component6
            endchoice
        endif

    config MCUX_COMPONENT_componentB
        bool "Component B, pattern 2 choise"
        select MCUX_COMPONENT_component1 
        select MCUX_COMPONENT_component2
        depends on MCUX_COMPILER_IAR || MCUX_COMPILER_MDK
        # All device scope shall be explicitly specified here, otherwise for a device which is not in the scope which means the dependency is not satisfied, but componentC is still showed and configurable
        depends on MCUX_HW_DEVICE_MK64F12 || MCUX_HW_DEVICE_MK63F12 || MCUX_HW_DEVICE_LPC54005 || MCUX_HW_DEVICE_LPC54016

        if MCUX_COMPONENT_componentB
            choice
                prompt "ComponentB anyOf"
                default MCUX_DEPENDENCY_COMPONENT_componentC_DEPEND_ALLOF_1
                config MCUX_DEPENDENCY_COMPONENT_componentC_DEPEND_ALLOF_1
                    bool "Select component3 and component 4 in device MK64F12, MK63F12"
                    select MCUX_COMPONENT_component3
                    select MCUX_COMPONENT_component4
                    depends on MCUX_HW_DEVICE_MK64F12 || MCUX_HW_DEVICE_MK63F12

                config MCUX_DEPENDENCY_COMPONENT_componentC_DEPEND_ALLOF_2
                    bool "Select component5 and component4"
                    select MCUX_COMPONENT_component5
                    select MCUX_COMPONENT_component6
                    depends on MCUX_HW_DEVICE_LPC54005 || MCUX_HW_DEVICE_LPC54016
            endchoice         
        endif

    config MCUX_COMPONENT_componentB1
        bool "Component B, pattern 2 select"
        select MCUX_COMPONENT_component1 
        select MCUX_COMPONENT_component2
        depends on MCUX_COMPILER_IAR || MCUX_COMPILER_MDK
        # All device scope shall be explicitly specified here, otherwise for a device which is not in the scope which means the dependency is not satisfied, but componentC is still showed and configurable
        depends on MCUX_HW_DEVICE_MK64F12 || MCUX_HW_DEVICE_MK63F12 || MCUX_HW_DEVICE_LPC54005 || MCUX_HW_DEVICE_LPC54016
        select MCUX_COMPONENT_component3 if MCUX_HW_DEVICE_MK64F12 || MCUX_HW_DEVICE_MK63F12
        select MCUX_COMPONENT_component5 if MCUX_HW_DEVICE_LPC54005 || MCUX_HW_DEVICE_LPC54016        
    
    config MCUX_COMPONENT_componentC
        bool "Component C, pattern 3"
        if MCUX_COMPONENT_componentC
            choice
                prompt "Component C anyOf"
                default MCUX_DEPENDENCY_COMPONENT_componentC_DEPEND_ALLOF_component1_component2
                config MCUX_DEPENDENCY_COMPONENT_componentC_DEPEND_ALLOF_component1_component2
                    bool "Select component1 and component2"
                    select MCUX_COMPONENT_component1
                    select MCUX_COMPONENT_component2
                    depends on MCUX_HW_CORE_CM4 || MCUX_HW_CORE_CM4F
                    depends on MCUX_HW_DEVICE_MK64F12 || MCUX_HW_DEVICE_MK63F12

                config MCUX_DEPENDENCY_COMPONENT_componentC_DEPEND_ALLOF_component3_component4
                    bool "Select component3 and component4"
                    select MCUX_COMPONENT_component3
                    select MCUX_COMPONENT_component4
            endchoice         
        endif
    
    config MCUX_COMPONENT_component1
        bool "Component1"
    config MCUX_COMPONENT_component2
        bool "Component2"
    config MCUX_COMPONENT_component3
        bool "Component3"
    config MCUX_COMPONENT_component4
        bool "Component4"
    config MCUX_COMPONENT_component5
        bool "Component5"
    config MCUX_COMPONENT_component6
        bool "Component6"
    config MCUX_COMPONENT_component7
        bool "Component7"
    config MCUX_COMPONENT_component8
        bool "Component8"
    config MCUX_COMPONENT_component9
        bool "Component9"   
    config MCUX_COMPONENT_component10
        bool "Component10"                                
        # depends on MCUX_HW_CORE_CM33                                                            
endmenu
```
